// selftest.c — on-device self-test of the Lemtone path (see selftest.h).
//
// Everything is printed with integers only (newlib-nano has no float printf). Each
// check prints "PASS"/"FAIL" and the run ends with one "SELFTEST PASS" or
// "SELFTEST FAIL <n>" line that tools/selftest_watch.py waits for.

#include "selftest.h"
#include "config.h"

#if LEMTONE_SELFTEST

#include <math.h>
#include <stdio.h>
#include <stdlib.h>
#include <string.h>

#include "freertos/FreeRTOS.h"
#include "freertos/task.h"
#include "esp_system.h"
#include "esp_timer.h"

#include "bulb_config.h"
#include "controller.h"
#include "lemtone.h"
#include "protocol.h"
#include "sniffer.h"

// lemtone/test, generated by calibration/lemtone_ref.py for the model this device links
#ifdef LEMTONE_VECTORS
#include LEMTONE_VECTORS
#else
#include "lemtone_vectors.h"
#endif

#define N_OF(a) ((int)(sizeof(a) / sizeof((a)[0])))

static int s_checks, s_fails;

static void check(bool ok, const char *what) {
    s_checks++;
    if (!ok) s_fails++;
    printf("ST %s  %s\n", ok ? "PASS" : "FAIL", what);
}

static int cmp_u32(const void *a, const void *b) {
    const uint32_t x = *(const uint32_t *)a, y = *(const uint32_t *)b;
    return x < y ? -1 : x > y;
}

// ---- 1. reference vectors on this chip ---------------------------------------------

static uint32_t s_t_mode[4][N_OF(SOLVE_VECS)];

static void test_vectors(const lemtone_ctx_t *ctx) {
    printf("ST ---- 1. reference vectors (%d forward, %d solve) ----\n", N_OF(FWD_VECS), N_OF(SOLVE_VECS));

    // forward model
    float worst_fwd = 0;
    const int64_t f0 = esp_timer_get_time();
    for (int k = 0; k < N_OF(FWD_VECS); k++) {
        float X[3];
        lemtone_forward(ctx, FWD_VECS[k].d, X);
        for (int c = 0; c < 3; c++) {
            const float ref = FWD_VECS[k].xyz[c];
            const float err = fabsf(X[c] - ref) / (fabsf(ref) + 1.0f);
            if (err > worst_fwd) worst_fwd = err;
        }
    }
    const int64_t f1 = esp_timer_get_time();
    printf("ST forward: worst rel diff %d e-9, %d us per evaluation\n", (int)(worst_fwd * 1e9f),
           (int)((f1 - f0) / N_OF(FWD_VECS)));
    check(worst_fwd < 1e-4f, "forward model matches reference");

    int n_mode[4] = {0}, mode_diff = 0, period_diff = 0, tick_diff = 0;
    uint32_t evals_max = 0;
    float worst_duty = 0;
    for (int k = 0; k < N_OF(SOLVE_VECS); k++) {
        const solve_vec_t *v = &SOLVE_VECS[k];
        lemtone_solution_t s;
        const int64_t t0 = esp_timer_get_time();
        lemtone_solve(ctx, v->a, v->b, v->lm, v->f, &s);
        const uint32_t us = (uint32_t)(esp_timer_get_time() - t0);
        if (s.evals > evals_max) evals_max = s.evals;
        if (s.mode < 4) s_t_mode[s.mode][n_mode[s.mode]++] = us;
        if (s.mode != v->mode) {
            mode_diff++;
            printf("ST   mode differs at #%d: chip %d ref %d\n", k, s.mode, v->mode);
        } else if (s.mode == LEMTONE_EXACT) {
            for (int i = 0; i < 5; i++) worst_duty = fmaxf(worst_duty, fabsf(s.duty[i] - v->duty[i]));
            uint8_t per[5];
            lemtone_pwm_t q;
            lemtone_periods(&LEMTONE_PERIOD_DEFAULT, s.duty, s.lm, per);
            lemtone_quantize(ctx, s.duty, per, &q);
            for (int i = 0; i < 5; i++) {
                if (per[i] != v->period[i]) period_diff++;
                if (abs((int)q.ticks[i] - (int)v->ticks[i]) > 1) tick_diff++;
            }
        }
        vTaskDelay(1);  // let the idle task feed the watchdog
    }

    static const char *names[4] = {"OFF", "EXACT", "DESAT", "CLAMP"};
    for (int m = 0; m < 4; m++) {
        if (!n_mode[m]) continue;
        qsort(s_t_mode[m], (size_t)n_mode[m], sizeof(uint32_t), cmp_u32);
        printf("ST solve %-5s n=%3d  us: min %6u  median %6u  p90 %6u  max %6u\n", names[m], n_mode[m],
               s_t_mode[m][0], s_t_mode[m][n_mode[m] / 2], s_t_mode[m][n_mode[m] * 9 / 10],
               s_t_mode[m][n_mode[m] - 1]);
    }
    printf("ST solve: %d mode mismatches, worst exact duty diff %d e-9, %d period / %d tick diffs, "
           "max evals %u\n", mode_diff, (int)(worst_duty * 1e9f), period_diff, tick_diff, evals_max);
    check(mode_diff <= N_OF(SOLVE_VECS) / 100, "solve modes match reference (<=1% boundary cases)");
    check(worst_duty < 2e-3f, "exact solve duties match reference");
    check(period_diff == 0 && tick_diff == 0, "periods and ticks match reference");
}

// ---- wire encoding (mirror of the base station's lt_encode) -------------------------

static int clampi(int v, int lo, int hi) { return v < lo ? lo : (v > hi ? hi : v); }

static uint64_t lt_word(float a, float b, float lm, float f) {
    const int ca = clampi((int)lroundf(a / PROTO_LT_AB_STEP) + PROTO_LT_A_OFFSET, 0, 2047);
    const int cb = clampi((int)lroundf(b / PROTO_LT_AB_STEP) + PROTO_LT_B_OFFSET, 0, 2047);
    const int cl = lm > 0.0f
        ? clampi((int)lroundf(log2f(lm) * PROTO_LT_LUM_PER_OCTAVE) + PROTO_LT_LUM_ZERO, 1, 4095) : 0;
    const int cf = clampi((int)lroundf(f * (float)PROTO_LT_F_MAX), 0, PROTO_LT_F_MAX);
    return (uint64_t)ca | ((uint64_t)cb << PROTO_LT_B_SHIFT) | ((uint64_t)cl << PROTO_LT_LUM_SHIFT) |
           ((uint64_t)cf << PROTO_LT_F_SHIFT);
}

// A beacon carrying a 0x07 table, as the base station builds it. Returns its length.
static size_t lt_frame(uint8_t *p, const uint8_t *ids, const uint64_t *words, int count) {
    size_t n = 0;
    p[n++] = 0x80;
    p[n++] = 0x00;
    for (int i = 0; i < 34; i++) p[n++] = 0x00;  // rest of MAC header + fixed params
    p[n++] = IE_TAG_VENDOR;
    const size_t len_at = n++;
    p[n++] = VENDOR_OUI_0;
    p[n++] = VENDOR_OUI_1;
    p[n++] = VENDOR_OUI_2;
    p[n++] = PROTO_TAG_LEMTONE_UPDATE;
    p[n++] = (uint8_t)count;
    for (int i = 0; i < count; i++) {
        p[n++] = ids[i];
        for (int k = 0; k < 5; k++) p[n++] = (uint8_t)(words[i] >> (8 * k));
    }
    p[len_at] = (uint8_t)(n - len_at - 1);
    return n;
}

static uint8_t s_id;

// Inject one value for this bulb (alongside two other bulbs' entries, as in a real table).
static void send(float a, float b, float lm, float f) {
    uint8_t frame[128];
    const uint8_t ids[3] = {(uint8_t)(s_id + 1), s_id, (uint8_t)(s_id - 1)};
    const uint64_t w[3] = {lt_word(0.1f, 0.1f, 50.0f, 0.5f), lt_word(a, b, lm, f), lt_word(0, 0, 0, 0)};
    sniffer_inject(frame, (uint32_t)lt_frame(frame, ids, w, 3));
}

static controller_lemtone_stats_t cstats(void) {
    controller_lemtone_stats_t s;
    controller_get_lemtone_stats(&s);
    return s;
}

static sniffer_lt_stats_t sstats(void) {
    sniffer_lt_stats_t s;
    sniffer_get_lt_stats(&s);
    return s;
}

// Wait until the controller has applied `n` values in total (or timeout).
static bool wait_applies(uint32_t n, int timeout_ms) {
    for (int t = 0; t < timeout_ms; t += 10) {
        if (cstats().applies >= n) return true;
        vTaskDelay(pdMS_TO_TICKS(10));
    }
    return false;
}

// ---- 2. the RX -> controller path -------------------------------------------------

static void test_path(void) {
    printf("ST ---- 2. 0x07 through the RX path (bulb id %u) ----\n", s_id);
    char msg[96];
    const uint32_t a0 = cstats().applies;
    const sniffer_lt_stats_t s0 = sstats();

    send(0.0744f, 0.1536f, 300.0f, 1.0f);  // 2700K 300 lm
    check(wait_applies(a0 + 1, 2000), "new value is solved and applied");

    for (int k = 0; k < 5; k++) send(0.0744f, 0.1536f, 300.0f, 1.0f);
    vTaskDelay(pdMS_TO_TICKS(300));
    sniffer_lt_stats_t s1 = sstats();
    snprintf(msg, sizeof msg, "5 repeats dropped before the controller (repeats +%u, applies +%u)",
             s1.repeats - s0.repeats, cstats().applies - a0);
    check(s1.repeats - s0.repeats == 5 && cstats().applies == a0 + 1, msg);

    // other bulbs only, and malformed frames: nothing reaches the controller
    uint8_t frame[128];
    const uint8_t other[1] = {(uint8_t)(s_id + 7)};
    const uint64_t ow[1] = {lt_word(0.3f, 0.0f, 100.0f, 0.0f)};
    sniffer_inject(frame, (uint32_t)lt_frame(frame, other, ow, 1));
    const uint8_t mine[1] = {s_id};
    size_t len = lt_frame(frame, mine, ow, 1);
    frame[37] = (uint8_t)(frame[37] - 1);  // IE claims one byte less than the entry needs
    sniffer_inject(frame, (uint32_t)(len - 1));
    frame[37] = (uint8_t)(frame[37] + 1);
    frame[42] = 12;                         // entry_count over the limit
    sniffer_inject(frame, (uint32_t)len);
    vTaskDelay(pdMS_TO_TICKS(300));
    check(cstats().applies == a0 + 1 && sstats().posted == s1.posted, "other ids and malformed frames ignored");

    send(-0.0040f, 0.0024f, 200.0f, 1.0f);  // CW-ish 200 lm
    check(wait_applies(a0 + 2, 2000), "changed value is applied");

    // keep-alive: repeats alone must hold the light past the fallback timeout
    const uint32_t fb_ms = bulb_config_get_u32(CFG_FALLBACK_MS);
    const uint32_t fb0 = cstats().fallbacks;
    printf("ST keep-alive: repeating for %u ms (fallback %u ms)...\n", fb_ms + 3000, fb_ms);
    for (uint32_t t = 0; t < fb_ms + 3000; t += 1000) {
        send(-0.0040f, 0.0024f, 200.0f, 1.0f);
        vTaskDelay(pdMS_TO_TICKS(1000));
    }
    check(cstats().fallbacks == fb0 && cstats().applies == a0 + 2, "repeats keep the light (no fallback, no re-solve)");

    // silence: the fallback fires, then the same value must repaint
    printf("ST fallback: silent for %u ms...\n", fb_ms + 2500);
    vTaskDelay(pdMS_TO_TICKS(fb_ms + 2500));
    check(cstats().fallbacks == fb0 + 1, "fallback fires after silence");
    send(-0.0040f, 0.0024f, 200.0f, 1.0f);
    check(wait_applies(a0 + 3, 2000), "same value re-applied after the fallback");
}

// ---- 3. visible sequence ----------------------------------------------------------

typedef struct {
    const char *name;
    float a, b, lm, f;
} preset_t;

// OKLab chromaticities from the tool page's presets
static const preset_t PRESETS[] = {
    {"2700K 480 lm", 0.0744f, 0.1536f, 480.0f, 1.0f},  {"4000K 600 lm", 0.0328f, 0.0800f, 600.0f, 1.0f},
    {"6500K 600 lm", 0.0088f, -0.0056f, 600.0f, 1.0f}, {"rated 1000 lm (clamps)", 0.0448f, 0.0608f, 1000.0f, 1.0f},
    {"red 30 lm", 0.4616f, 0.2192f, 30.0f, 0.0f},      {"amber 180 lm", 0.1464f, 0.2256f, 180.0f, 0.5f},
    {"green 72 lm", -0.5176f, 0.2040f, 72.0f, 0.0f},   {"blue 15 lm", 0.0584f, -0.9408f, 15.0f, 0.0f},
    {"pink 90 lm", 0.2048f, -0.0304f, 90.0f, 0.5f},    {"candle 6 lm", 0.1432f, 0.2032f, 6.0f, 1.0f},
    {"red night light 0.5 lm", 0.4616f, 0.2192f, 0.5f, 0.0f}, {"imaginary violet 20 lm", 0.79f, -1.12f, 20.0f, 0.5f},
};

static void fade(const char *name, float a, float b, float f, float lm_hi, float lm_lo, int steps, int step_ms) {
    printf("ST fade %s: %d -> %d mlm -> back, %d steps each way @ %d ms\n", name, (int)(lm_hi * 1000),
           (int)(lm_lo * 1000), steps, step_ms);
    for (int k = 0; k <= 2 * steps; k++) {
        const float t = k <= steps ? (float)k / steps : (float)(2 * steps - k) / steps;
        send(a, b, lm_hi * powf(lm_lo / lm_hi, t), f);
        vTaskDelay(pdMS_TO_TICKS(step_ms));
    }
}

static void test_visible(void) {
    printf("ST ---- 3. visible sequence ----\n");
    for (int k = 0; k < N_OF(PRESETS); k++) {
        const preset_t *p = &PRESETS[k];
        printf("ST show %s\n", p->name);
        send(p->a, p->b, p->lm, p->f);
        vTaskDelay(pdMS_TO_TICKS(2500));
    }
    // across the 180 / 60 lm period tiers and down to the long-period region
    fade("2700K F1", 0.0744f, 0.1536f, 1.0f, 400.0f, 0.2f, 120, 100);
    fade("red F0 (desat path)", 0.4616f, 0.2192f, 0.0f, 40.0f, 0.05f, 60, 100);
}

// ---- driver -----------------------------------------------------------------------

static void selftest_task(void *arg) {
    (void)arg;
    vTaskDelay(pdMS_TO_TICKS(3000));  // let boot logging settle
    s_id = bulb_config_get_u8(CFG_BULB_ID);
    printf("\nST ==== LEMTONE SELFTEST (bulb id %u, heap free %u B) ====\n", s_id, esp_get_free_heap_size());

    static lemtone_ctx_t ctx;
    lemtone_init(&ctx, &LEMTONE_MODEL_DEFAULT);
    printf("ST model %s, lm_per_y %d e-6\n", ctx.m->id, (int)(ctx.m->lm_per_y * 1e6f));

    test_vectors(&ctx);
    test_path();
    test_visible();

    const controller_lemtone_stats_t c = cstats();
    const sniffer_lt_stats_t s = sstats();
    printf("ST ---- summary ----\n");
    printf("ST controller: %u applies, solve max %u us, pwm publish max %u us, min free stack %u B, %u fallbacks\n",
           c.applies, c.max_solve_us, c.max_pwm_us, c.min_stack_free, c.fallbacks);
    printf("ST sniffer: %u posted, %u repeats dropped, %u lost to a full queue\n", s.posted, s.repeats, s.dropped);
    printf("ST heap free %u B, selftest task stack free %u B\n", esp_get_free_heap_size(),
           (unsigned)uxTaskGetStackHighWaterMark(NULL));
    check(s.dropped == 0, "no values lost to a full controller queue");
    check(c.min_stack_free >= 512, "controller stack margin >= 512 B");
    if (s_fails) printf("ST SELFTEST FAIL %d of %d\n", s_fails, s_checks);
    else printf("ST SELFTEST PASS (%d checks)\n", s_checks);
    printf("ST bulb falls back to its default in %u ms; normal operation continues\n",
           bulb_config_get_u32(CFG_FALLBACK_MS));
    vTaskDelete(NULL);
}

void selftest_start(void) {
    xTaskCreate(selftest_task, "selftest", 4096, NULL, 2, NULL);
}

#else

void selftest_start(void) {}

#endif  // LEMTONE_SELFTEST
